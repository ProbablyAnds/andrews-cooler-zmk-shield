#include <behaviors.dtsi>
#include <dt-bindings/zmk/keys.h>

/ {
    keymap {
        compatible = "zmk,keymap";
            bindings = <
                &kp ESC    &kp N1   &kp N2 &kp N3    &kp N4 &kp N5       &kp N6   &kp N7 &kp N8    &kp N9  &kp N0   &kp GRAVE
                &kp TAB    &kp Q    &kp W  &kp E     &kp R  &kp T        &kp Y    &kp U  &kp I     &kp O   &kp P    &kp MINUS
                &kp LSHFT  &kp A    &kp S  &kp D     &kp F  &kp G        &studio_unlock    &kp J  &kp K     &kp L   &kp SEMI &kp SQT
                &kp LCTRL  &kp Z    &kp X  &kp C     &studio_unlock  &kp B        &kp N    &kp M  &kp COMMA &kp DOT &kp FSLH &kp RSHFT
                &kp LALT   &kp LGUI &mo 1  &kp SPACE &kp RET             &kp BSPC &mo 2  &kp RGUI
            >;
        };
    };
 };
