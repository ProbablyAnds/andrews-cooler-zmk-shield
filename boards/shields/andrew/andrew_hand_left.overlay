&kgoh_jian_6col_layout {
    row-gpios
        = <&gpio1 6 (GPIO_ACTIVE_HIGH | GPIO_PULL_DOWN)>,
          <&gpio1 4 (GPIO_ACTIVE_HIGH | GPIO_PULL_DOWN)>,
          <&gpio0 11 (GPIO_ACTIVE_HIGH | GPIO_PULL_DOWN)>,
          <&gpio1 00 (GPIO_ACTIVE_HIGH | GPIO_PULL_DOWN)>,
          <&gpio0 24 (GPIO_ACTIVE_HIGH | GPIO_PULL_DOWN)>,
          <&gpio0 22 (GPIO_ACTIVE_HIGH | GPIO_PULL_DOWN)>,
          <&gpio0 20 (GPIO_ACTIVE_HIGH | GPIO_PULL_DOWN)>;

    col-gpios
        = <&gpio0  9 GPIO_ACTIVE_HIGH>,
          <&gpio0  10 GPIO_ACTIVE_HIGH>,
          <&gpio1  11 GPIO_ACTIVE_HIGH>,
          <&gpio1  13 GPIO_ACTIVE_HIGH>,
          <&gpio1  15 GPIO_ACTIVE_HIGH>;
};
